/**
 * sd_storage.h
 * YieldVision — SD Card Module
 *
 * Module: MicroSD card module (with onboard 5V→3.3V level converter)
 * Library: SD.h (built into Arduino IDE)
 *          ArduinoJson by Benoit Blanchon (install via Library Manager, v6.x)
 *
 * Wiring to Arduino Mega:
 *   SD VCC  → 5V
 *   SD GND  → GND
 *   SD CS   → pin 53  (hardware SPI CS on Mega)
 *   SD SCK  → pin 52  (hardware SPI SCK)
 *   SD MOSI → pin 51  (hardware SPI MOSI)
 *   SD MISO → pin 50  (hardware SPI MISO)
 *
 * SD card structure:
 *   /FARM_PROFILE.json  — farm zones, soil types, planted crops
 *   /DATA/YYYYMMDD.csv  — sensor readings for that day (one file per day)
 *   /SYNCED.log         — list of files already uploaded to server
 *
 * JSON farm profile format (loaded at rover boot, generated by Python setup tool):
 * {
 *   "farm_id":   "uuid-string",
 *   "farm_name": "Kamau's Farm",
 *   "zones": [
 *     {
 *       "zone_id":    "uuid-string",
 *       "zone_label": "A1",
 *       "soil_type":  "loam",
 *       "crop_name":  "maize",
 *       "planting_date": "2026-01-15",
 *       "polygon": [
 *         {"lat": -0.1234, "lon": 36.5678},
 *         {"lat": -0.1234, "lon": 36.5680},
 *         {"lat": -0.1236, "lon": 36.5680},
 *         {"lat": -0.1236, "lon": 36.5678}
 *       ]
 *     }
 *   ]
 * }
 */

#ifndef SD_STORAGE_H
#define SD_STORAGE_H

#include <Arduino.h>
#include <SD.h>
#include <ArduinoJson.h>

#define SD_CS_PIN       53
#define FARM_PROFILE_FILE  "/FARM_PROFILE.json"
#define SYNC_LOG_FILE      "/SYNCED.log"
#define DATA_DIR           "/DATA"
#define MAX_ZONES          20    // Max zones we'll hold in RAM
#define MAX_POLYGON_VERTS  8     // Max polygon vertices per zone

// ── Zone data held in RAM after profile load ─────────────────────────────────
struct ZonePolygonVert {
  double lat;
  double lon;
};

struct ZoneProfile {
  char   zone_id[40];
  char   zone_label[8];
  char   soil_type[16];
  char   crop_name[20];
  char   planting_date[12];   // "YYYY-MM-DD"
  ZonePolygonVert polygon[MAX_POLYGON_VERTS];
  uint8_t polygon_size;
  bool   active;
};

// ── Farm profile held in RAM ──────────────────────────────────────────────────
struct FarmProfile {
  char       farm_id[40];
  char       farm_name[50];
  ZoneProfile zones[MAX_ZONES];
  uint8_t    zone_count;
  bool       loaded;
};

static FarmProfile _farm;

// ── Point-in-polygon (ray casting algorithm) ──────────────────────────────────
/**
 * Returns true if point (lat, lon) is inside the given polygon.
 * Works for convex and concave polygons.
 * Algorithm: ray casting — count crossings of a horizontal ray from the point.
 */
static bool pointInPolygon(double lat, double lon,
                            const ZonePolygonVert* poly, uint8_t n) {
  bool inside = false;
  uint8_t j = n - 1;
  for (uint8_t i = 0; i < n; i++) {
    double xi = poly[i].lon, yi = poly[i].lat;
    double xj = poly[j].lon, yj = poly[j].lat;
    bool crosses = ((yi > lat) != (yj > lat)) &&
                   (lon < (xj - xi) * (lat - yi) / (yj - yi) + xi);
    if (crosses) inside = !inside;
    j = i;
  }
  return inside;
}

// ── Public API ────────────────────────────────────────────────────────────────

bool sd_begin() {
  if (!SD.begin(SD_CS_PIN)) {
    Serial.println(F("[SD] Init failed — check card and wiring"));
    return false;
  }
  Serial.println(F("[SD] Card OK"));
  _farm.loaded = false;

  // Make data directory if it doesn't exist
  if (!SD.exists(DATA_DIR)) SD.mkdir(DATA_DIR);

  return true;
}

/**
 * Load farm profile from SD card into RAM.
 * Must be called before zone detection.
 * Returns false if FARM_PROFILE.json is missing or malformed.
 */
bool sd_loadFarmProfile() {
  if (!SD.exists(FARM_PROFILE_FILE)) {
    Serial.println(F("[SD] FARM_PROFILE.json not found — run farm setup first"));
    return false;
  }

  File f = SD.open(FARM_PROFILE_FILE, FILE_READ);
  if (!f) {
    Serial.println(F("[SD] Cannot open FARM_PROFILE.json"));
    return false;
  }

  // 4KB doc — enough for ~20 zones with 8-vertex polygons each
  StaticJsonDocument<4096> doc;
  DeserializationError err = deserializeJson(doc, f);
  f.close();

  if (err) {
    Serial.print(F("[SD] JSON parse error: "));
    Serial.println(err.c_str());
    return false;
  }

  // Copy into static struct
  strlcpy(_farm.farm_id,   doc["farm_id"]   | "unknown", sizeof(_farm.farm_id));
  strlcpy(_farm.farm_name, doc["farm_name"] | "unknown", sizeof(_farm.farm_name));

  JsonArray zones = doc["zones"];
  _farm.zone_count = 0;

  for (JsonObject z : zones) {
    if (_farm.zone_count >= MAX_ZONES) break;

    ZoneProfile& zp = _farm.zones[_farm.zone_count];
    strlcpy(zp.zone_id,       z["zone_id"]       | "unknown", sizeof(zp.zone_id));
    strlcpy(zp.zone_label,    z["zone_label"]    | "?",       sizeof(zp.zone_label));
    strlcpy(zp.soil_type,     z["soil_type"]     | "loam",    sizeof(zp.soil_type));
    strlcpy(zp.crop_name,     z["crop_name"]     | "unknown", sizeof(zp.crop_name));
    strlcpy(zp.planting_date, z["planting_date"] | "",        sizeof(zp.planting_date));
    zp.active = true;

    // Load polygon vertices
    JsonArray poly = z["polygon"];
    zp.polygon_size = 0;
    for (JsonObject v : poly) {
      if (zp.polygon_size >= MAX_POLYGON_VERTS) break;
      zp.polygon[zp.polygon_size].lat = v["lat"].as<double>();
      zp.polygon[zp.polygon_size].lon = v["lon"].as<double>();
      zp.polygon_size++;
    }

    _farm.zone_count++;
  }

  _farm.loaded = true;
  Serial.print(F("[SD] Farm profile loaded: "));
  Serial.print(_farm.farm_name);
  Serial.print(F(" — "));
  Serial.print(_farm.zone_count);
  Serial.println(F(" zones"));
  return true;
}

/**
 * Identify which zone a GPS coordinate falls in.
 * Uses point-in-polygon against all loaded zone polygons.
 * Returns pointer to matching ZoneProfile, or nullptr if no match.
 */
const ZoneProfile* sd_detectZone(double lat, double lon) {
  if (!_farm.loaded) {
    Serial.println(F("[SD] Farm profile not loaded"));
    return nullptr;
  }

  for (uint8_t i = 0; i < _farm.zone_count; i++) {
    ZoneProfile& z = _farm.zones[i];
    if (!z.active) continue;
    if (z.polygon_size < 3) continue;   // Need at least 3 vertices for a polygon

    if (pointInPolygon(lat, lon, z.polygon, z.polygon_size)) {
      Serial.print(F("[SD] Zone detected: "));
      Serial.println(z.zone_label);
      return &z;
    }
  }

  Serial.println(F("[SD] No zone matched this GPS position"));
  return nullptr;
}

/** Get the farm_id from loaded profile */
const char* sd_getFarmId() {
  return _farm.loaded ? _farm.farm_id : "unknown";
}

// ── DATA LOGGING ──────────────────────────────────────────────────────────────

/**
 * Build today's data file path: /DATA/YYYYMMDD.csv
 * date_str should be in format "YYYYMMDD" from GPS or RTC.
 */
static void _buildDataPath(char* buf, const char* date_str) {
  snprintf(buf, 32, "%s/%s.csv", DATA_DIR, date_str);
}

/**
 * Write a CSV header row if the file is new (empty).
 * Called automatically by sd_logReading if file is new.
 */
static void _writeCSVHeader(File& f) {
  f.println(F(
    "timestamp,zone_id,zone_label,farm_id,"
    "nitrogen_ppm,phosphorus_ppm,potassium_ppm,"
    "ph,soil_moisture_pct,soil_temp_c,ec_us_cm,"
    "air_temp_c,air_humidity_pct,"
    "gps_lat,gps_lon,gps_accuracy_m,"
    "data_quality,sequence_number"
  ));
}

/**
 * Log one sensor reading to the day's CSV file.
 * timestamp: ISO-ish string e.g. "2026-03-11T14:23:00"
 * sequence:  rover's reading counter for this boot session
 */
bool sd_logReading(
  const char* timestamp,
  const char* date_str,       // "YYYYMMDD" for file naming
  const char* zone_id,
  const char* zone_label,
  float nitrogen, float phosphorus, float potassium,
  float ph,
  float moisture, float soil_temp, float ec,
  float air_temp, float air_hum,
  double lat, double lon, float gps_acc,
  float data_quality,
  uint16_t sequence
) {
  char path[32];
  _buildDataPath(path, date_str);

  bool is_new = !SD.exists(path);
  File f = SD.open(path, FILE_WRITE);

  if (!f) {
    Serial.print(F("[SD] Cannot open for write: "));
    Serial.println(path);
    return false;
  }

  if (is_new) _writeCSVHeader(f);

  // Write data row
  f.print(timestamp);    f.print(',');
  f.print(zone_id);      f.print(',');
  f.print(zone_label);   f.print(',');
  f.print(sd_getFarmId()); f.print(',');

  // Soil NPK
  if (nitrogen   >= 0) f.print(nitrogen, 0); else f.print(F("NA")); f.print(',');
  if (phosphorus >= 0) f.print(phosphorus, 0); else f.print(F("NA")); f.print(',');
  if (potassium  >= 0) f.print(potassium, 0); else f.print(F("NA")); f.print(',');

  // Soil conditions
  if (ph       >= 0) f.print(ph, 1); else f.print(F("NA")); f.print(',');
  if (moisture >= 0) f.print(moisture, 1); else f.print(F("NA")); f.print(',');
  if (soil_temp > -999) f.print(soil_temp, 1); else f.print(F("NA")); f.print(',');
  if (ec       >= 0) f.print(ec, 0); else f.print(F("NA")); f.print(',');

  // Air
  if (air_temp > -999) f.print(air_temp, 1); else f.print(F("NA")); f.print(',');
  if (air_hum  >= 0)   f.print(air_hum, 1);  else f.print(F("NA")); f.print(',');

  // GPS
  if (lat != 0) f.print(lat, 6); else f.print(F("NA")); f.print(',');
  if (lon != 0) f.print(lon, 6); else f.print(F("NA")); f.print(',');
  if (gps_acc < 900) f.print(gps_acc, 1); else f.print(F("NA")); f.print(',');

  f.print(data_quality, 2); f.print(',');
  f.println(sequence);

  f.close();
  return true;
}

/**
 * List all unsynced data files (not recorded in SYNCED.log).
 * Returns count. Files stored in out_files[] up to max_files.
 */
uint8_t sd_listUnsyncedFiles(char out_files[][32], uint8_t max_files) {
  uint8_t count = 0;
  File dir = SD.open(DATA_DIR);
  if (!dir) return 0;

  while (count < max_files) {
    File entry = dir.openNextFile();
    if (!entry) break;

    char name[32];
    entry.getName(name, sizeof(name));
    entry.close();

    // Check if already in SYNCED.log
    bool already_synced = false;
    if (SD.exists(SYNC_LOG_FILE)) {
      File syncLog = SD.open(SYNC_LOG_FILE, FILE_READ);
      while (syncLog.available()) {
        String line = syncLog.readStringUntil('\n');
        line.trim();
        if (line == String(name)) { already_synced = true; break; }
      }
      syncLog.close();
    }

    if (!already_synced) {
      char full[32];
      snprintf(full, sizeof(full), "%s/%s", DATA_DIR, name);
      strlcpy(out_files[count], full, 32);
      count++;
    }
  }

  dir.close();
  return count;
}

/** Mark a file as synced by appending its name to SYNCED.log */
void sd_markSynced(const char* filename) {
  File f = SD.open(SYNC_LOG_FILE, FILE_WRITE);
  if (f) {
    // Get just the filename without path
    const char* name = strrchr(filename, '/');
    f.println(name ? name + 1 : filename);
    f.close();
  }
}

/** Read a data file and stream its contents to Serial (for debugging) */
void sd_dumpFile(const char* path) {
  if (!SD.exists(path)) {
    Serial.print(F("[SD] File not found: ")); Serial.println(path);
    return;
  }
  File f = SD.open(path, FILE_READ);
  while (f.available()) Serial.write(f.read());
  f.close();
}

/** Returns how many lines (readings) are in a file (excludes header) */
uint16_t sd_countReadings(const char* path) {
  if (!SD.exists(path)) return 0;
  File f = SD.open(path, FILE_READ);
  uint16_t count = 0;
  bool first = true;
  while (f.available()) {
    f.readStringUntil('\n');
    if (!first) count++;   // Skip header row
    first = false;
  }
  f.close();
  return count;
}

#endif // SD_STORAGE_H
